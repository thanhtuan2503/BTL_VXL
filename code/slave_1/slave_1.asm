
	 SLAV_0 EQU 30H
	 ORG 0
	 LJMP MAIN
	 ORG 0023H
	 LJMP ISR_SPI
	 ORG 0030H
MAIN: 
	 MOV SP,#5FH
	 MOV SCON,#0F2H ;SPI mode 3 cho phép thu,TI=1
	 MOV TMOD,#20H ;Timer1 tạo baudrate
	 MOV TH1, #-3 ;BR=9600
	 MOV TL1,TH1
	 SETB TR1
	 SETB EA
	 SETB ES
	 MOV P1, #0FFH
LOOP:	 	SETB SM2
			ACALL CHECK
			JNB SM2, MOD_SL
			MOV A, P1
			MOV P2, A
			SJMP LOOP
MOD_SL:	 	ACALL THU
			MOV P2, A
			JZ LOOP
			MOV A, P1
			ACALL PHAT
			SJMP MOD_SL


CHECK:		JNB RB8, KT
			CJNE A, #SLAV_0, KT
			CLR SM2
KT:			CLR RB8
			RET

ISR_SPI:	JNB TI, THU 
PHAT:
	 CLR TI
	 MOV SBUF,A
	 SJMP FN
THU: MOV A,SBUF
	 CLR RI
FN:	 RETI
END